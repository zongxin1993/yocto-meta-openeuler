## bsp/meta-openeuler-bsp/conf/machine/include/cip-core.inc
```bitbake
DEBIAN_BASED = "${@bb.utils.contains('CIP_CORE', '1', 'debian', 'nondebian', d)}"
#DEBIAN_BASED = "nondebian"
OVERRIDES .= ":${DEBIAN_BASED}"

BBMASK:append:nondebian = " recipes-debian"

BBMASK:append:debian = " perl_debian"

# Select gcc,gdb, python3 debian version
GCCVERSION_debian = "8.3.0"
SDKGCCVERSION_debian = "${GCCVERSION}"

GLIBCVERSION_debian = "2.31%"
PREFERRED_VERSION_glibc_debian = "${GLIBCVERSION}"
PREFERRED_VERSION_nativesdk-glibc_debian = "${GLIBCVERSION}"
PREFERRED_VERSION_nativesdk-glibc-locale_debian = "${GLIBCVERSION}" 

BINUVERSION_debian = "2.31.%"
PREFERRED_VERSION_nativesdk-binutils_debian = "${BINUVERSION}"

PREFERRED_VERSION_gdb_debian = "9.1"

PREFERRED_VERSION_busybox_debian = "1.31.%"

RDEPENDS:xz:append:debian = "bash"
RDEPENDS:gzip:append:debian = "bash"
RDEPENDS:adduser:append:debian = "perl"
```

## bsp/meta-openeuler-bsp/conf/machine/openeuler-ok3568.conf
```bitbake
RK3568_KERNEL_DTB_NAME ?= "OK3568-C-linux.dtb"
KERNEL_DEVICETREE = "rockchip/${RK3568_KERNEL_DTB_NAME}"

UBOOT_MACHINE = "evb-rk3568_defconfig"

CMDLINE_SERIAL = "console=tty1 console=ttyFIQ0,115200"
SERIAL_CONSOLES = "115200;ttyFIQ0"
AUTO-EXPAND-FS = "1"
```

## bsp/meta-openeuler-bsp/conf/machine/tspi-rk3566.conf
```bitbake
require conf/machine/include/rk356x.inc
require conf/machine/include/rockchip-common.inc

# Specify the U-Boot configuration
UBOOT_MACHINE = "rk3568_defconfig"

# Specify the linux kernel configuration and device tree
KBUILD_DEFCONFIG = ""
ROCKCHIP_KERNEL_DTB_NAME = "tspi-rk3566-user-v10-linux.dtb"
KERNEL_DEVICETREE = "rockchip/${ROCKCHIP_KERNEL_DTB_NAME}"

# serial console setting
SERIAL_CONSOLES = "1500000;ttyFIQ0"

UBOOT_EXTLINUX_ROOT ?= "root=/dev/mmcblk1p2 rootfstype=ext4 "

PREFERRED_PROVIDER_virtual/kernel = "linux-openeuler"
PREFERRED_PROVIDER_virtual/bootloader = "u-boot-rockchip"
```

## bsp/meta-visionfive2/conf/machine/starfive-dubhe.conf
```bitbake
#@TYPE: Machine
#@NAME: unmatched
#@SOC: Freedom U740
#@DESCRIPTION: Machine configuration for the Unmatched development board
require conf/machine/include/riscv/tune-riscv.inc

MACHINEOVERRIDES =. "visionfive:mriscv64:"
MACHINE_FEATURES = "screen keyboard ext2 ext3 serial alsa pci usbhost"
DEFAULTTUNE ?= "riscv64"

export ROOTFS_PACKAGE_ARCH = "riscv64"

KERNEL_IMAGETYPE = "Image.gz"
KERNEL_IMAGETYPE_FOR_MAKE = "Image.gz"

BASE_LIB_tune-riscv64 = "lib64/lp64d"

require conf/multilib.conf
MULTILIBS = "" 

SERIAL_CONSOLES = "115200;ttyS0"

RISCV_SBI_FDT ?=  "jh7110-visionfive-v2.dtb"
KERNEL_DEVICETREE ?= "starfive/${RISCV_SBI_FDT}"  

PREFERRED_PROVIDER_virtual/bootloader ?= "u-boot"
PREFERRED_PROVIDER_virtual/kernel = "linux-starfive"

RISCV_SBI_PLAT = "generic"

MACHINE_EXTRA_RRECOMMENDS += " kernel-modules"

## Do not update fstab file when using wic images
#WIC_CREATE_EXTRA_ARGS ?= "--no-fstab-update"

EXTRA_IMAGEDEPENDS += "u-boot"
UBOOT_MACHINE = "sifive_unmatched_defconfig"

# U-Boot SPL
SPL_BINARY ?= "spl/u-boot-spl.bin"

# U-Boot ITB (FIT image with U-Boot S-mode, OpenSBI FW_DYNAMIC, DTB [from
# U-Boot source code tree])
UBOOT_SUFFIX ?= "itb"

## wic default support
WKS_FILE_DEPENDS ?= " \
    opensbi \
    e2fsprogs-native \
    bmap-tools-native \
"

IMAGE_BOOT_FILES ?= " \
    Image.gz-initramfs-unmatched.bin \
    jh7110-visionfive-v2.dtb \
    demo-single-2-unmatched.tar \
"

WKS_FILE ?= "starfive-dubhe-initramfs.wks"

BAD_RECOMMENDATIONS += "\
    libcxx-dev \
    libcxx-staticdev \
    compiler-rt-dev \
    compiler-rt-staticdev \
"

ASSUME_PROVIDED += "\
    libcxx-dev \
    libcxx-staticdev \
    compiler-rt-dev \
    compiler-rt-staticdev \
"
```

## meta-clang/conf/distro/include/tcmode-external-clang.inc
```bitbake
EXTERNAL_CLANG ?= "clang"
CLANG_VERSION = "${@get_clang_version(d)}"
CLANG_VERSION_allarch = ""
CLANG_VERSION[vardepvalue] = "${CLANG_VERSION}"
BUILDCFG_VARS += "CLANG_VERSION"

# use gcc sysroot now
HOST_CC_ARCH:remove:toolchain-clang = "-target ${HOST_SYS}"
# for target, use gcc sysroot
HOST_CC_ARCH:prepend:class-target:toolchain-clang = "--target=${EXTERNAL_TARGET_SYS} "
# for native recipe, use prebuilt tool
# HOST_CC_ARCH:prepend:class-native:toolchain-clang = "--target=x86_64-openeulersdk-linux "

# no need for clang
HOST_CC_ARCH:remove:toolchain-clang = "--no-sysroot-suffix"

def get_clang_version(d):
    import os.path
    import re
    import subprocess
    import oe.path
    import bb
    version_output = ""
    toolchain_bin = d.getVar('EXTERNAL_TOOLCHAIN_CLANG_BIN')
    if toolchain_bin:
        path = os.path.join(toolchain_bin, d.getVar('EXTERNAL_CLANG'))
        cmd = path + " --version | head -n1"
        bb.debug(1, 'oe.external.run({})'.format(cmd))
        version_output = subprocess.getoutput(cmd)
        # clang version xx.yy.zz, here we get xx.yy.zz
        match = re.search("[0-9]+\.[0-9]+\.[0-9]", version_output)
        if match:
            return match.group()
    return 'UNKNOWN'
```

## meta-openeuler/conf/machine/qemu-riscv64.conf
```bitbake
# Description: Config for riscv64 machine

MACHINEOVERRIDES =. "mriscv64:"
DEFAULTTUNE = "riscv64"

export ROOTFS_PACKAGE_ARCH = "riscv64"

require conf/machine/qemu-common.inc
KERNEL_IMAGETYPE = "Image"
KERNEL_IMAGETYPE_FOR_MAKE = "Image"

require conf/machine/include/riscv/tune-riscv.inc
BASE_LIB_tune-riscv64 = "lib64"

require conf/multilib.conf
MULTILIBS ?= ""
```

## rtos/meta-uniproton/conf/layer.conf
```bitbake
# We have a conf and classes directory, add to BBPATH
BBPATH .= ":${LAYERDIR}"

# We have recipes-* directories, add to BBFILES
BBFILES += "${LAYERDIR}/recipes-*/*.bb \
            ${LAYERDIR}/recipes-*/*.bbappend"

BBFILE_COLLECTIONS += "uniproton"
BBFILE_PATTERN_uniproton = "^${LAYERDIR}/"
BBFILE_PRIORITY_uniproton = "24"

LAYERVERSION_uniproton = "1"

LAYERDEPENDS_uniproton = "core"

LAYERSERIES_COMPAT_uniproton = "kirkstone"
```
